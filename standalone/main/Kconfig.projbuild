## standalone/main/Kconfig.projbuild
```kconfig
menu "Tesla BLE Firmware Configuration"

    config WIFI_SSID
        string "Wi-Fi SSID"
        default "Tesla_BLE_Control"
        help
            The SSID (name) of your Wi-Fi network.

    config WIFI_PASSWORD
        string "Wi-Fi Password"
        default "secure_password"
        help
            The password of your Wi-Fi network.

    config WIFI_HOTSPOT_PASSWORD
        string "Wi-Fi Hotspot Password"
        default "tesla-ble-setup"
        help
            The password for the fallback Wi-Fi hotspot.

    config MQTT_BROKER_URL
        string "MQTT Broker URL"
        default "mqtt://homeassistant.local:1883"
        help
            The Home Assistant MQTT broker URL (e.g., mqtt://homeassistant.local:1883).

    config MQTT_USERNAME
        string "MQTT Username"
        default ""
        help
            The username for the MQTT broker (optional).

    config MQTT_PASSWORD
        string "MQTT Password"
        default ""
        help
            The password for the MQTT broker (optional).

    config VEHICLE_VIN
        string "Tesla Vehicle VIN"
        default "5YJ3E1EBXLFXXXXXX"
        help
            The VIN of your Tesla vehicle to identify topics and autodiscovery entities.

    config BLE_MAC_ADDRESS
        string "Target Tesla BLE MAC Address"
        default ""
        help
            The MAC address of the target Tesla vehicle (e.g., 74:46:B3:04:47:16). If empty, scans for any Tesla.

    config API_ENCRYPTION_KEY
        string "API Encryption Key"
        default ""
        help
            The API encryption key for secure pairing and communications.

    config OTA_PASSWORD
        string "OTA Password"
        default "ota_placeholder"
        help
            The password for Over-The-Air updates.

endmenu
```

## standalone/sdkconfig.defaults
```kconfig
# ESP-IDF SDK configuration defaults for pure-Zig Tesla BLE firmware
CONFIG_IDF_TARGET="esp32c6"

# Configure Bluetooth Stack to use NimBLE (C-native stack, highly efficient)
CONFIG_BT_ENABLED=y
CONFIG_BT_CONTROLLER_ENABLED=y
CONFIG_BT_NIMBLE_ENABLED=y
CONFIG_BT_NIMBLE_MAX_CONNECTIONS=3
CONFIG_BT_NIMBLE_HOST_TASK_STACK_SIZE=10240


# Memory and Partition sizes
CONFIG_ESP_DEFAULT_CPU_FREQ_MHZ_160=y
CONFIG_ESP_MAIN_TASK_STACK_SIZE=24576
CONFIG_PARTITION_TABLE_CUSTOM=y
CONFIG_PARTITION_TABLE_CUSTOM_FILENAME="partitions.csv"
CONFIG_PARTITION_TABLE_FILENAME="partitions.csv"
CONFIG_PARTITION_TABLE_OFFSET=0x8000
CONFIG_ESPTOOLPY_FLASHSIZE_4MB=y
CONFIG_ESPTOOLPY_FLASHSIZE="4MB"

# Wi-Fi configurations
CONFIG_ESP_WIFI_ENABLED=y

# Custom Tesla BLE Configuration Defaults
CONFIG_WIFI_SSID="your_wifi_ssid"
CONFIG_WIFI_PASSWORD="your_wifi_password"
CONFIG_WIFI_HOTSPOT_PASSWORD="tesla-ble-setup"
CONFIG_MQTT_BROKER_URL="mqtt://homeassistant.local:1883"
CONFIG_MQTT_USERNAME="your_mqtt_username"
CONFIG_MQTT_PASSWORD="your_mqtt_password"
CONFIG_VEHICLE_VIN="your_vehicle_vin"
CONFIG_BLE_MAC_ADDRESS="your_ble_mac_address"
CONFIG_API_ENCRYPTION_KEY="your_api_encryption_key_base64"
CONFIG_VEHICLE_PUBLIC_KEY="your_vehicle_public_key_hex"
CONFIG_OTA_PASSWORD="your_ota_password"
```
